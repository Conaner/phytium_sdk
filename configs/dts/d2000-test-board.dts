/* SPDX-License-Identifier: BSD-2-Clause */

/dts-v1/;

/ {
	#address-cells = <0x02>;
	#size-cells = <0x02>;

	amba {
		compatible = "simple-bus";
		#address-cells = <0x02>;
		#size-cells = <0x02>;
		ranges;

		interrupt-controller@29a00000 {
			compatible = "arm,gic-400";
			#address-cells = <0x02>;
			#interrupt-cells = <0x03>;
			reg = <0x00 0x29a00000 0x00 0x10000>;
			interrupt-controller;
			phandle = <0x01>;
		};

		pcie@40000000 {
			compatible = "pci-host-ecam-generic";
			status = "okay";
			device_type = "pci";
			#address-cells = <3>;
			#size-cells = <2>;
			#interrupt-cells = <1>;
			interrupt-parent = <0x01>;
			interrupts = <0x00 28 0x04>;
			reg = <0 0x40000000 0 0x10000000>;
			ranges = <0x01000000 0x00 0x00000000 0x0  0x50000000  0x0  0x00f00000
                      0x02000000 0x00 0x58000000 0x0 0x58000000 0x0 0x28000000
                      0x03000000 0x10 0x00000000 0x10 0x00000000 0x10  0x00000000>;
			bus-range = <0 255>;
		};

	};
};